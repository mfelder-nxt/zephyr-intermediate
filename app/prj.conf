## prj.conf
```kconfig
CONFIG_LOG=y
CONFIG_LOG_DEFAULT_LEVEL=3
CONFIG_LOG_MODE_DEFERRED=y
CONFIG_LOG_RATELIMIT=y
CONFIG_LOG_RATELIMIT_INTERVAL_MS=1000

CONFIG_THREAD_NAME=y
CONFIG_THREAD_MONITOR=y

CONFIG_SHELL=y
CONFIG_KERNEL_SHELL=y
CONFIG_SHELL_LOG_BACKEND=n
# Defaults to n when the serial shell is enabled
CONFIG_LOG_BACKEND_UART=y

CONFIG_INIT_STACKS=y
CONFIG_THREAD_STACK_INFO=y

CONFIG_CONSOLE=y

CONFIG_TRACING=y
CONFIG_TRACING_CTF=y
CONFIG_TRACING_SYNC=y
CONFIG_TRACING_BACKEND_UART=y
CONFIG_TRACING_PACKET_MAX_SIZE=64
# Capture uart1 (tracing UART) to build/channel0_0
CONFIG_QEMU_EXTRA_FLAGS="-serial file:channel0_0"

CONFIG_MAIN_STACK_SIZE=2048

CONFIG_LOG_RATELIMIT=y
CONFIG_LOG_RATELIMIT_INTERVAL_MS=1000
```

## src/main.c
```c
#include <zephyr/kernel.h>
#include <zephyr/logging/log.h>
#include <zephyr/tracing/tracing.h>

LOG_MODULE_REGISTER(homework, LOG_LEVEL_INF);

#define STACK_SIZE 2048
#define CONTROL_PRIORITY 7
#define MAINTENANCE_PRIORITY 4
#define EVENT_PERIOD_MS 250
#define MAINTENANCE_LOAD_US 45000

#define DEADLINE_MS 40

struct control_event {
  uint32_t seq;
  uint32_t ready_ms;
};

K_MSGQ_DEFINE(control_queue, sizeof(struct control_event), 4, 4);
K_SEM_DEFINE(maintenance_start, 0, 1);

/* ================================================================== */
/*  Timer expiry: creates one control event                           */
/* ================================================================== */

static void event_timer_expiry(struct k_timer *timer) {
  ARG_UNUSED(timer);

  static uint32_t seq;
  struct control_event event = {
      .seq = seq++,
      .ready_ms = k_uptime_get_32(),
  };

  /* Timer expiry runs in interrupt context, so never wait here. */
  int ret = k_msgq_put(&control_queue, &event, K_NO_WAIT);

  if (ret != 0) {
    return;
  }

  /* Both threads become ready when the timer interrupt returns. */
  k_sem_give(&maintenance_start);
  sys_trace_named_event("maintenance start ready", event.seq, 4);
}

K_TIMER_DEFINE(event_timer, event_timer_expiry, NULL);

/* ================================================================== */
/*  Control thread                                                   */
/* ================================================================== */

static void control_fn(void *p1, void *p2, void *p3) {
  ARG_UNUSED(p1);
  ARG_UNUSED(p2);
  ARG_UNUSED(p3);
  uint32_t deadline_misses = 0;

  while (true) {
    struct control_event event;
    int ret = k_msgq_get(&control_queue, &event, K_FOREVER);

    if (ret != 0) {
      LOG_ERR("[CONTROL] receive failed: %d", ret);
      continue;
    }
    uint32_t latency = k_uptime_get_32() - event.ready_ms;

    LOG_INF("[CONTROL] processed seq=%u, latency_ms=%u", event.seq, latency);

    if (latency > DEADLINE_MS) {
      deadline_misses++;
      LOG_WRN_RATELIMIT("deadline_miss count=%u, seq=%u, latency_ms=%u",
                        deadline_misses, event.seq, latency);
    }
    sys_trace_named_event("control_done", event.seq, latency);
  }
}

/* ================================================================== */
/*  Background maintenance thread                                    */
/* ================================================================== */

static void maintenance_fn(void *p1, void *p2, void *p3) {
  ARG_UNUSED(p1);
  ARG_UNUSED(p2);
  ARG_UNUSED(p3);

  while (true) {
    k_sem_take(&maintenance_start, K_FOREVER);

    /* This work is important, but it has no short deadline. */
    k_busy_wait(MAINTENANCE_LOAD_US);
  }
}

K_THREAD_DEFINE(control, STACK_SIZE, control_fn, NULL, NULL, NULL,
                CONTROL_PRIORITY, 0, 0);

K_THREAD_DEFINE(maintenance, STACK_SIZE, maintenance_fn, NULL, NULL, NULL,
                MAINTENANCE_PRIORITY, 0, 0);

int main(void) {
  LOG_INF("=== L6 Homework: Runtime Investigation ===");
  LOG_INF("Control work must start within 10 ms");
  LOG_INF("Inspect, measure, trace, explain, and correct the delay");

  k_timer_start(&event_timer, K_MSEC(500), K_MSEC(EVENT_PERIOD_MS));

  return 0;
}
```
